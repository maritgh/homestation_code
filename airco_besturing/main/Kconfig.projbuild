## airco_besturing/main/Kconfig.projbuild
```kconfig
menu "Airco besturing"

config AIRCO_WIFI_SSID
    string "Wi-Fi SSID"
    default ""
    help
        SSID van het Wi-Fi-netwerk waarop de ESP32 moet aanmelden.

config AIRCO_WIFI_PASSWORD
    string "Wi-Fi password"
    default ""
    help
        Wachtwoord van het Wi-Fi-netwerk. Laat leeg voor een open netwerk.

endmenu
```

## complete_code/main/Kconfig.projbuild
```kconfig
menu "Homestation"

    config WIFI_SSID
        string "Wi-Fi SSID"
        default "Iphone_van_marit"
        help
            SSID van het Wi-Fi-netwerk waarop de ESP32 moet aanmelden.

    config WIFI_PASSWORD
        string "Wi-Fi password"
        default "hoi hoi hoi"
        help
            Wachtwoord van het Wi-Fi-netwerk. Laat leeg voor een open netwerk.

endmenu
```

## complete_code/sdkconfig.defaults
```kconfig
CONFIG_IDF_TARGET="esp32s3"
CONFIG_ESPTOOLPY_FLASHSIZE_2MB=y
CONFIG_LV_CONF_SKIP=y
CONFIG_LV_BUILD_EXAMPLES=n
CONFIG_LV_USE_OBSERVER=n
CONFIG_LV_USE_SYSMON=n
CONFIG_PARTITION_TABLE_CUSTOM=y
CONFIG_PARTITION_TABLE_CUSTOM_FILENAME="partitions.csv"
```

## wind_meter/main/Kconfig.projbuild
```kconfig
menu "Wind meter"
    config WIND_NS_DATA_GPIO
        int "North/south HX711 data GPIO"
        default 5
    config WIND_NS_CLOCK_GPIO
        int "North/south HX711 clock GPIO"
        default 6
    config WIND_EW_DATA_GPIO
        int "East/west HX711 data GPIO"
        default 7
    config WIND_EW_CLOCK_GPIO
        int "East/west HX711 clock GPIO"
        default 8
    config WIND_NS_CALIBRATION
        string "North/south calibration (raw counts per gram)"
        default "-708.900330"
    config WIND_EW_CALIBRATION
        string "East/west calibration (raw counts per gram)"
        default "699.668091"
    config WIND_PLATE_DIAMETER_MM
        int "Circular plate diameter in mm"
        range 1 1000
        default 80
    config WIND_TEMPERATURE_C
        string "Air temperature in Celsius"
        default "28.50"
    config WIND_PRESSURE_HPA
        string "Air pressure in hPa"
        default "1017.25"
    config WIND_HUMIDITY_PERCENT
        int "Relative humidity in percent"
        range 0 100
        default 75
endmenu
```
